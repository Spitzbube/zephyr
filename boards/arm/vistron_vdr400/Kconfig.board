## boards/arm/vistron_vdr400/Kconfig.board
```kconfig
# Vistron VDR400 board configuration

# Copyright (c) 2023 Spitzbube@mail.bg
# SPDX-License-Identifier: Apache-2.0

config BOARD_VISTRON_VDR400
	bool "Vistron VDR400 Development Board"
	depends on SOC_STM32F103XE
```

## boards/arm/vistron_vdr400/Kconfig.defconfig
```kconfig
# Vistron VDR400 board configuration

# Copyright (c) 2023 Spitzbube@mail.bg
# SPDX-License-Identifier: Apache-2.0

if BOARD_VISTRON_VDR400

config BOARD
	default "vistron_vdr400"

endif # BOARD_VISTRON_VDR400
```
